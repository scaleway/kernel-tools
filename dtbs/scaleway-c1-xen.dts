/*
 * Device Tree file for Online-Labs C1 Computing
 *
 * Copyright (C) 2014-2015 Scaleway
 *
 * Manfred Touron <mtouron@scaleway.com>
 * Vincent Auclair <vauclair@online.net>
 *
 * This file is licensed under the terms of the GNU General Public
 * License version 2.  This program is licensed "as is" without any
 * warranty of any kind, whether express or implied.
 */

#include "scaleway-c1.dts"

/ {
	pmodel = "Scaleway - C1 XEN";
	compatible = "marvell,axp-db", "marvell,armadaxp-mv78460", "marvell,armadaxp", "marvell,armada-370-xp", "xen,xen-4.5", "xen,xen";

	chosen {
		xen,xen-bootargs = "earlyprintk=ttyS0 nousb console=ttyS0,9600n8 debug guest_loglvl=all loglvl=all dom0_mem=128M,max:128M";
		xen,dom0-bootargs = "console=ttyAMA1 debug rw init=/bin/sh";
		module@0 {
			compatible = "xen,linux-zimage", "xen,multiboot-module";
			reg = <0 0x8000000 0 0x355fd8>;
			bootargs = "console=hvc0 ro root=/dev/nbd0 INITRD_PRE_SHELL=1 INITRD_POST_SHELL=1 clk_ignore_unused";
		};
	};
};
